/dts-v1/;
/plugin/;

/ {
  compatible = "anbernic,rg353p";

  fragment@0 {
    target-path = "/";
    __overlay__ {
      #address-cells = <2>;
      #size-cells = <2>;

      mpp_srv: mpp-srv {
        compatible = "rockchip,mpp-service";
        rockchip,taskqueue-count = <6>;
        rockchip,resetgroup-count = <6>;
        status = "okay";
      };

      rkvenc: rkvenc@fdf40000 {
        compatible = "rockchip,rkv-encoder-v1";
        reg = <0x0 0xfdf40000 0x0 0x400>;
        interrupt-parent = <&gic>;
        interrupts = <0 140 4>;
        interrupt-names = "irq_enc";
        clocks = <&cru 259>, <&cru 260>, <&cru 261>;
        clock-names = "aclk_vcodec", "hclk_vcodec", "clk_core";
        rockchip,normal-rates = <297000000>, <0>, <297000000>;
        resets = <&cru 307>, <&cru 308>, <&cru 309>;
        reset-names = "video_a", "video_h", "video_core";
        assigned-clocks = <&cru 259>, <&cru 261>;
        assigned-clock-rates = <297000000>, <297000000>;
        iommus = <&rkvenc_mmu>;
        rockchip,srv = <&mpp_srv>;
        rockchip,taskqueue-node = <3>;
        rockchip,resetgroup-node = <3>;
        power-domains = <&power 14>;
        status = "okay";
      };

      rkvenc_mmu: iommu@fdf40f00 {
        compatible = "rockchip,rk3568-iommu";
        reg = <0x0 0xfdf40f00 0x0 0x40>,
              <0x0 0xfdf40f40 0x0 0x40>;
        interrupt-parent = <&gic>;
        interrupts = <0 141 4>, <0 142 4>;
        interrupt-names = "rkvenc_mmu0", "rkvenc_mmu1";
        clocks = <&cru 259>, <&cru 260>;
        clock-names = "aclk", "iface";
        rockchip,disable-mmu-reset;
        #iommu-cells = <0>;
        power-domains = <&power 14>;
        status = "okay";
      };
    };
  };
};
